## meta-local/conf/distro/rpi-distro.conf
```bitbake
require conf/distro/poky.conf

DISTRO = "rpi-distro"

#VOLATILE_LOG_DIR = "no"

DISTRO_FEATURES:append = " systemd virtualization"
```

## meta-local/conf/layer.conf
```bitbake
# We have a conf and classes directory, add to BBPATH
BBPATH .= ":${LAYERDIR}"

# We have recipes-* directories, add to BBFILES
BBFILES += "${LAYERDIR}/recipes-*/*/*.bb \
            ${LAYERDIR}/recipes-*/*/*.bbappend"

BBFILE_COLLECTIONS += "meta-local"
BBFILE_PATTERN_meta-local = "^${LAYERDIR}/"
BBFILE_PRIORITY_meta-local = "6"

LAYERDEPENDS_meta-local = "core"
LAYERSERIES_COMPAT_meta-local = "kirkstone"
```
